//
// Created by leonm on 2023/2/11.
// OLED驱动源码地址：github.com/olikraus/u8g2
//
//

#include "Inc/u8g2_OLED.h"
#include "u8g2.h"
#include "i2c.h"
#include "stdio.h"

/*******************************************获取I2C地址以及引脚定义*******************************************/
uint8_t u8x8_byte_i2c(u8x8_t *u8x8, uint8_t msg, uint8_t arg_int, void *arg_ptr)
{
    static uint8_t buffer[32];		/* u8g2/u8x8 will never send more than 32 bytes between START_TRANSFER and END_TRANSFER */
    static uint8_t buf_idx;
    uint8_t *data;

    switch(msg)
    {
        case U8X8_MSG_BYTE_SEND:
            data = (uint8_t *)arg_ptr;
            while( arg_int > 0 )
            {
                buffer[buf_idx++] = *data;
                data++;
                arg_int--;
            }
            break;
        case U8X8_MSG_BYTE_START_TRANSFER:
            buf_idx = 0;
            break;
        case U8X8_MSG_BYTE_END_TRANSFER:
            HAL_I2C_Master_Transmit(&hi2c1, u8x8_GetI2CAddress(u8x8), buffer, buf_idx, 500);
            break;
        default:
            return 0;
    }
    return 1;
}
/*******************************************获取I2C地址以及引脚定义*******************************************/

/**********************************************OLED微秒延时函数**********************************************/
uint8_t u8x8_delay(u8x8_t *u8x8, uint8_t msg, uint8_t arg_int, void *arg_ptr)
{
    switch (msg)
    {
        case U8X8_MSG_DELAY_MILLI:
            HAL_Delay(arg_int);

            break;
            //Function which delays 10us
        case U8X8_MSG_DELAY_10MICRO:
            for (uint16_t n = 0; n < 320; n++)
            {
                __NOP();
            }

            break;
            //Function which delays 100ns
        case U8X8_MSG_DELAY_100NANO:
            __NOP();
            break;
        default:
            return 0;
    }
    return 1;
}
/**********************************************OLED微秒延时函数**********************************************/

/************************************************OLED初始化************************************************/
void oled_Init(u8g2_t *u8g2) {
    u8g2_Setup_sh1107_i2c_128x80_f(u8g2, U8G2_R3, u8x8_byte_i2c, u8x8_delay);
    u8g2_InitDisplay(u8g2); // send init sequence to the display, display is in sleep mode after this,
    u8g2_ClearDisplay(u8g2);   //清空屏幕
    u8g2_SetPowerSave(u8g2, 0); // wake up display
}
/************************************************OLED初始化************************************************/
#define SEND_BUFFER_DISPLAY_MS(u8g2, ms)\
  do {\
    u8g2_SendBuffer(u8g2); \
    HAL_Delay(ms);\
  }while(0);
/************************************************OLED初始化************************************************/


/************************************************下面是测试例子************************************************/
//测试例子来自这个网址： blog.csdn.net/black_sneak/article/details/126312657
/************************************************OLED绘图函数************************************************/
void draw(u8g2_t *u8g2)
{
    u8g2_ClearBuffer(u8g2);

    u8g2_SetFontMode(u8g2, 1); /*字体模式选择*/
    u8g2_SetFontDirection(u8g2, 0); /*字体方向选择*/
    u8g2_SetFont(u8g2, u8g2_font_inb24_mf); /*字库选择*/
    u8g2_DrawStr(u8g2, 0, 20, "U");

    u8g2_SetFontDirection(u8g2, 1);
    u8g2_SetFont(u8g2, u8g2_font_inb30_mn);
    u8g2_DrawStr(u8g2, 21,8,"8");

    u8g2_SetFontDirection(u8g2, 0);
    u8g2_SetFont(u8g2, u8g2_font_inb24_mf);
    u8g2_DrawStr(u8g2, 51,30,"g");
    u8g2_DrawStr(u8g2, 67,30,"\xb2");

    u8g2_DrawHLine(u8g2, 2, 35, 47);
    u8g2_DrawHLine(u8g2, 3, 36, 47);
    u8g2_DrawVLine(u8g2, 45, 32, 12);
    u8g2_DrawVLine(u8g2, 46, 33, 12);

    u8g2_SetFont(u8g2, u8g2_font_4x6_tr);
    u8g2_DrawStr(u8g2, 1,54,"github.com/olikraus/u8g2");

    u8g2_SetFont(u8g2, u8g2_font_4x6_tr);
    u8g2_DrawStr(u8g2, 1,64,"github.com/leon-red/St1x");

    u8g2_SendBuffer(u8g2);
    HAL_Delay(1500);
}
/************************************************练习************************************************/

void LeonTest(u8g2_t *u8g2)
{
    u8g2_ClearBuffer(u8g2);//清屏？
    char testStr[14] = "TEST OK";

    u8g2_ClearBuffer(u8g2);//清屏？

    u8g2_SetFont(u8g2,u8g2_font_ncenB10_tr);
    u8g2_DrawStr(u8g2,0,40,testStr);
    SEND_BUFFER_DISPLAY_MS(u8g2,1000);
}
/************************************************练习************************************************/

/************************************************画点填充************************************************/
void testDrawPixelToFillScreen(u8g2_t *u8g2)
{
    int t = 1000;
    u8g2_ClearBuffer(u8g2);

    for (int j = 0; j < 64; j++)
    {
        for (int i = 0; i < 128; i++)
        {
            u8g2_DrawPixel(u8g2,i, j);
        }
    }
    HAL_Delay(1000);
}
/************************************************画点填充************************************************/

/************************************************U8g2测试函数************************************************/
#define SEND_BUFFER_DISPLAY_MS(u8g2, ms)\
  do {\
    u8g2_SendBuffer(u8g2); \
    HAL_Delay(ms);\
  }while(0);
/************************************************U8g2测试函数************************************************/

/************************************************OLED进度条测试函数************************************************/
void testDrawProcess(u8g2_t *u8g2)
{
    for(int i=10;i<=128;i=i+10)
    {
        u8g2_ClearBuffer(u8g2);

        char buff[20];
        sprintf(buff,"%d%%",(int)(i/128.0*100));

        u8g2_SetFont(u8g2,u8g2_font_ncenB18_tf);
        u8g2_DrawStr(u8g2,0,32,"St1x U8g2");//字符显示

        u8g2_SetFont(u8g2,u8g2_font_ncenB08_tf);
        u8g2_DrawStr(u8g2,56,48,buff);//当前进度显示

        u8g2_DrawRBox(u8g2,0,56,i,10,4);//圆角填充框矩形框
        u8g2_DrawRFrame(u8g2,0,56,128,10,4);//圆角矩形

        u8g2_SendBuffer(u8g2);
    }
}
/************************************************OLED进度条测试函数************************************************/

/************************************************字体测试************************************************/
void testShowFont(u8g2_t *u8g2)
{
    int t = 1000;
    char testStr[14] = "STM32F103C8T6";

    u8g2_ClearBuffer(u8g2);

    u8g2_SetFont(u8g2,u8g2_font_u8glib_4_tf);
    u8g2_DrawStr(u8g2,0,5,testStr);
    SEND_BUFFER_DISPLAY_MS(u8g2,t);

    u8g2_SetFont(u8g2,u8g2_font_ncenB08_tf);
    u8g2_DrawStr(u8g2,0,30,testStr);
    SEND_BUFFER_DISPLAY_MS(u8g2,t);

    u8g2_SetFont(u8g2,u8g2_font_ncenB10_tr);
    u8g2_DrawStr(u8g2,0,60,testStr);
    SEND_BUFFER_DISPLAY_MS(u8g2,t);
}
/************************************************字体测试************************************************/

/************************************************画空心矩形************************************************/
void testDrawFrame(u8g2_t *u8g2)
{
    int t = 1000;
    int x = 16;
    int y = 32;
    int w = 50;
    int h = 20;
    u8g2_ClearBuffer(u8g2);
    u8g2_DrawStr(u8g2,0, 15, "DrawFrame");

    u8g2_DrawFrame(u8g2, x, y, w, h);
    SEND_BUFFER_DISPLAY_MS(u8g2,t);
    u8g2_DrawFrame(u8g2, x+w+5, y-10, w-20, h+20);
    SEND_BUFFER_DISPLAY_MS(u8g2,t);
}
/************************************************画空心矩形************************************************/

/************************************************画实心圆角矩形************************************************/
void testDrawRBox(u8g2_t *u8g2)
{
    int t = 1000;
    int x = 16;
    int y = 32;
    int w = 50;
    int h = 20;
    int r = 3;
    u8g2_ClearBuffer(u8g2);
    u8g2_DrawStr(u8g2,0, 15, "DrawRBox");

    u8g2_DrawRBox(u8g2, x, y, w, h, r);
    SEND_BUFFER_DISPLAY_MS(u8g2,t);
    u8g2_DrawRBox(u8g2, x+w+5, y-10, w-20, h+20, r);
    SEND_BUFFER_DISPLAY_MS(u8g2,t);
}
/************************************************画实心圆角矩形************************************************/

/************************************************画空心圆************************************************/
void testDrawCircle(u8g2_t *u8g2)
{
    int t = 600;
    int stx = 0;  //画图起始x
    int sty = 16; //画图起始y
    int with = 16;//一个图块的间隔
    int r = 15;   //圆的半径
    u8g2_ClearBuffer(u8g2);
    u8g2_DrawStr(u8g2, 0, 15, "DrawCircle");

    u8g2_DrawCircle(u8g2, stx, sty - 1 + with, r, U8G2_DRAW_UPPER_RIGHT); //右上
    SEND_BUFFER_DISPLAY_MS(u8g2,t);
    u8g2_DrawCircle(u8g2, stx + with, sty, r, U8G2_DRAW_LOWER_RIGHT); //右下
    SEND_BUFFER_DISPLAY_MS(u8g2,t);
    u8g2_DrawCircle(u8g2, stx - 1 + with * 3, sty - 1 + with, r, U8G2_DRAW_UPPER_LEFT); //左上
    SEND_BUFFER_DISPLAY_MS(u8g2,t);
    u8g2_DrawCircle(u8g2, stx - 1 + with * 4, sty, r, U8G2_DRAW_LOWER_LEFT); //左下
    SEND_BUFFER_DISPLAY_MS(u8g2,t);
    u8g2_DrawCircle(u8g2, stx - 1 + with * 2, sty - 1 + with * 2, r, U8G2_DRAW_ALL);//整个圆
    SEND_BUFFER_DISPLAY_MS(u8g2,t);

    u8g2_DrawCircle(u8g2, 32*3, 32, 31, U8G2_DRAW_ALL);//右侧整个圆
    SEND_BUFFER_DISPLAY_MS(u8g2,t);
}
/************************************************画空心圆************************************************/

/************************************************画实心椭圆************************************************/
void testDrawFilledEllipse(u8g2_t *u8g2)
{
    int t = 800;
    int with = 16;//一个图块的间隔
    int rx = 27;  //椭圆x方向的半径
    int ry = 22;  //椭圆y方向的半径
    u8g2_ClearBuffer(u8g2);
    u8g2_DrawStr(u8g2,0, 14, "DrawFilledEllipse");

    SEND_BUFFER_DISPLAY_MS(u8g2,t);
    u8g2_DrawFilledEllipse(u8g2, 0, with, rx, ry, U8G2_DRAW_LOWER_RIGHT);//右下
    SEND_BUFFER_DISPLAY_MS(u8g2,t);
    u8g2_DrawFilledEllipse(u8g2, with * 4 - 1, with, rx, ry, U8G2_DRAW_LOWER_LEFT); //左下
    SEND_BUFFER_DISPLAY_MS(u8g2,t);
    u8g2_DrawFilledEllipse(u8g2, 0, with * 4 - 1, rx, ry, U8G2_DRAW_UPPER_RIGHT); //右上
    SEND_BUFFER_DISPLAY_MS(u8g2,t);
    u8g2_DrawFilledEllipse(u8g2, with * 4 - 1, with * 4 - 1, rx, ry, U8G2_DRAW_UPPER_LEFT); //左上
    SEND_BUFFER_DISPLAY_MS(u8g2,t);
    u8g2_DrawFilledEllipse(u8g2, with * 6, with * 2.5, rx, ry, U8G2_DRAW_ALL);//整个椭圆
    SEND_BUFFER_DISPLAY_MS(u8g2,t);
}
/************************************************画实心椭圆************************************************/


/************************************************环形测试************************************************/
void testDrawMulti(u8g2_t *u8g2)
{
    u8g2_ClearBuffer(u8g2);
    for (int j = 0; j < 80; j+=16)
    {
        for (int i = 0; i < 128; i+=16)
        {
            u8g2_DrawPixel(u8g2, i, j);
            u8g2_SendBuffer(u8g2);
        }
    }

    //实心矩形逐渐变大
    u8g2_ClearBuffer(u8g2);
    for(int i=30; i>0; i-=2)
    {
        u8g2_DrawBox(u8g2,i*2,i,128-i*4,80-2*i);
        u8g2_SendBuffer(u8g2);
    }
    //空心矩形逐渐变小
    u8g2_ClearBuffer(u8g2);
    for(int i=0; i<40; i+=2)
    {
        u8g2_DrawFrame(u8g2,i*2,i,128-i*4,80-2*i);
        u8g2_SendBuffer(u8g2);
    }

    //实心圆角矩形逐渐变大
    u8g2_ClearBuffer(u8g2);
    for(int i=30; i>0; i-=2)
    {
        u8g2_DrawRBox(u8g2,i*2,i,128-i*4,80-2*i,10-i/3);
        u8g2_SendBuffer(u8g2);
    }
    //空心圆角矩形逐渐变小
    u8g2_ClearBuffer(u8g2);
    for(int i=0; i<40; i+=2)
    {
        u8g2_DrawRFrame(u8g2,i*2,i,128-i*4,80-2*i,10-i/3);
        u8g2_SendBuffer(u8g2);
    }

    //实心圆逐渐变大
    u8g2_ClearBuffer(u8g2);
    for(int i=2; i<80; i+=3)
    {
        u8g2_DrawDisc(u8g2,64,40,i, U8G2_DRAW_ALL);
        u8g2_SendBuffer(u8g2);
    }
    //空心圆逐渐变小
    u8g2_ClearBuffer(u8g2);
    for(int i=80; i>0; i-=3)
    {
        u8g2_DrawCircle(u8g2,64,40,i, U8G2_DRAW_ALL);
        u8g2_SendBuffer(u8g2);
    }

    //实心椭圆逐渐变大
    u8g2_ClearBuffer(u8g2);
    for(int i=2; i<40; i+=3)
    {
        u8g2_DrawFilledEllipse(u8g2,64,40, i*2, i, U8G2_DRAW_ALL);
        u8g2_SendBuffer(u8g2);
    }
    //空心椭圆逐渐变小
    u8g2_ClearBuffer(u8g2);
    for(int i=40; i>0; i-=3)
    {
        u8g2_DrawEllipse(u8g2,64,40, i*2, i, U8G2_DRAW_ALL);
        u8g2_SendBuffer(u8g2);
    }
}
/************************************************环形测试************************************************/

/************************************************一键三连************************************************/
// width: 128, height: 48
const unsigned char bilibili[] U8X8_PROGMEM = { 0x00, 0x00, 0x00, 0x00, 0x00, 0x00, 0x00, 0x00, 0x00, 0x00, 0x00, 0x00, 0x00,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 0x00, 0x00 };
// width: 128, height: 48
const unsigned char three_support[] U8X8_PROGMEM = { 0x00, 0x00, 0x00, 0x00, 0x00, 0x00, 0x00, 0x00, 0x00, 0x00, 0x00, 0x00, 0x00,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 0x00, 0x00 };
void testDrawXBM(u8g2_t *u8g2)
{
    int t = 1000;
    u8g2_ClearBuffer(u8g2);
    u8g2_DrawStr(u8g2,0, 14, "DrawXBM");

    u8g2_DrawXBM(u8g2,0, 16, 128, 48, bilibili);
    SEND_BUFFER_DISPLAY_MS(u8g2,t);

    u8g2_ClearBuffer(u8g2);
    u8g2_DrawStr(u8g2,0, 14, "bilibili");
    u8g2_DrawXBM(u8g2,0, 16, 128, 48, three_support);
    SEND_BUFFER_DISPLAY_MS(u8g2,t);
}
/************************************************一键三连************************************************/

//测试上面的例子
void u8g2DrawTest(u8g2_t *u8g2)
{
    LeonTest(u8g2);
    testDrawProcess(u8g2);
//    testDrawMulti(u8g2);
//    testDrawFrame(u8g2);
//    testDrawRBox(u8g2);
//    testDrawCircle(u8g2);
//    testDrawFilledEllipse(u8g2);
//    testShowFont(u8g2);
//    testDrawXBM(u8g2);
}
